## sound/soc/ma35d0/Kconfig
```kconfig
# SPDX-License-Identifier: GPL-2.0-only
##
## MA35D0 series I2S API
##
config SND_SOC_MA35D0
	tristate "SoC Audio for MA35D0 series"
	depends on ARCH_MA35D0
	help
	  This option enables support for I2S on the MA35D0 SoC.

##
## Boards
##
config SND_SOC_MA35D0EVB
	tristate "MA35D0 I2S support for demo board"
	depends on SND_SOC_MA35D0
	select SND_SOC_NAU8822
	select SND_SOC_GENERIC_DMAENGINE_PCM
	help
	  Select this option to enable audio (I2S) on the
	  MA35D0 demoboard.
```

## sound/soc/ma35d1/Kconfig
```kconfig
# SPDX-License-Identifier: GPL-2.0-only
##
## MA35D1 series I2S API
##
config SND_SOC_MA35D1
	tristate "SoC Audio for MA35D1 series"
	depends on ARCH_MA35D1
	help
	  This option enables support for I2S on the MA35D1 SoC.

##
## Boards
##
config SND_SOC_MA35D1EVB
	tristate "MA35D1 I2S support for demo board"
	depends on SND_SOC_MA35D1
	select SND_SOC_NAU8822
	select SND_SOC_GENERIC_DMAENGINE_PCM
	help
	  Select this option to enable audio (I2S) on the
	  MA35D1 demoboard.
```

## sound/soc/ma35h0/Kconfig
```kconfig
# SPDX-License-Identifier: GPL-2.0-only
##
## MA35H0 series I2S API
##
config SND_SOC_MA35H0
	tristate "SoC Audio for MA35H0 series"
	depends on ARCH_MA35H0
	help
	  This option enables support for I2S on the MA35H0 SoC.

##
## Boards
##
config SND_SOC_MA35H0EVB
	tristate "MA35H0 I2S support for demo board"
	depends on SND_SOC_MA35H0
	select SND_SOC_NAU8822
	select SND_SOC_GENERIC_DMAENGINE_PCM
	help
	  Select this option to enable audio (I2S) on the
	  MA35H0 demoboard.
```
