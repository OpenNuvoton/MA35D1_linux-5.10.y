## Documentation/devicetree/bindings/i2c/nuvoton,ma35d1-i2c.yaml
```yaml
# SPDX-License-Identifier: GPL-2.0
%YAML 1.2
---
$id: http://devicetree.org/schemas/i2c/nuvoton,ma35d1-i2c.yaml#
$schema: http://devicetree.org/meta-schemas/core.yaml#

title: Nuvoton MA35D1 I2C Controller

maintainers:
  - AAA <aaa@nuvoton.com>

allOf:
  - $ref: /schemas/i2c/i2c-controller.yaml#

properties:
  compatible:
    const: nuvoton,ma35d1-i2c

  reg:
    maxItems: 1

  interrupts:
    maxItems: 1

  clocks:
    maxItems: 1

  clock-frequency:
    enum: [ 100000, 400000 ]

  nuvoton,nfcnt:
    $ref: /schemas/types.yaml#/definitions/uint32
    minimum: 0
    maximum: 15
    default: 0
    description:
      Noise filter count field for CLKDIV[15:12]. This is a board-specific
      property that depends on PCB layout / bus noise conditions and should
      only be set (typically as a board-level override) on boards that
      require noise filtering. The SoC-level dtsi does not set a value for
      this property; if omitted, the driver programs this field to 0.

unevaluatedProperties: false

required:
  - compatible
  - reg
  - interrupts
  - clocks

examples:
  - |
    /* SoC-level node: nuvoton,nfcnt is intentionally omitted here.
     * Only boards that need noise filtering (e.g. due to PCB layout)
     * should set nuvoton,nfcnt, typically via a board-level override
     * such as:
     *
     *   &i2c1 {
     *       nuvoton,nfcnt = <5>;
     *       status = "okay";
     *   };
     */
    i2c1: i2c@40810000 {
      compatible = "nuvoton,ma35d1-i2c";
      reg = <0x0 0x40810000 0x0 0x10000>;
      interrupts = <69>;
      clocks = <&clk 10>;
      clock-frequency = <100000>;
      #address-cells = <1>;
      #size-cells = <0>;
    };
```
