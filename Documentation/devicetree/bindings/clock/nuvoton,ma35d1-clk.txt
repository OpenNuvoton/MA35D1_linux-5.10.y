## Documentation/devicetree/bindings/i2c/i2c-ma35d1.txt
```
Nuvoton MA35D1 I2C controller

Required properties:

- compatible: should be "nuvoton,ma35d1-i2c"
- clock-frequency: 32-bit decimal value of iic master clock freqency in Hz
- reg: specifies the base physical address and size of the registers
- interrupts: specifies the interrupt number, the irq line to be used

Example:

i2c1: i2c@40810000 {
		compatible = "nuvoton,ma35d1-i2c";
		reg = <0x0 0x40810000 0x0 0x10000>;
		interrupts = <GIC_SPI 69 IRQ_TYPE_EDGE_RISING>;
		clock-frequency = <100000>;
	};
```

## Documentation/devicetree/bindings/i2c/i2c-ma35d1.yaml
```yaml
# SPDX-License-Identifier: GPL-2.0
%YAML 1.2
---
$id: http://devicetree.org/schemas/i2c/i2c-ma35d1.yaml#
$schema: http://devicetree.org/meta-schemas/core.yaml#

title: NVT MA35D1 I2C Device Tree Bindings

maintainers:
  - AAA <aaa@nuvoton.com>

allOf:
  - $ref: /schemas/i2c/i2c-controller.yaml#

properties:
  compatible:
    items:
      - const: nuvoton,nua3500-i2c

  reg:
    maxItems: 1

  interrupts:
    maxItems: 1

  clocks:
    maxItems: 1

  clock-frequency:
    enum: [ 100000, 400000 ]

required:
  - compatible
  - reg
  - interrupts
  - clocks

examples:
  - 
    i2c1: i2c@40810000 {
		compatible = "nuvoton,nua3500-i2c";
		reg = <0x0 0x40810000 0x0 0x10000>;
		interrupts = <GIC_SPI 69 IRQ_TYPE_EDGE_RISING>;
		clock-frequency = <100000>;
        #address-cells = <1>;
		#size-cells = <0>;
	};
```

## Documentation/devicetree/bindings/iio/adc/ma35d1_eadc.txt
```
Nuvoton MA35D1 Enhanced Analog to Digital Converter (EADC)

The MA35D1 EADC is a 12-bit converter for eight channel inputs.

Required properties:
- compatible: "nuvoton,ma35d1-eadc" for the MA35D1 EADC.
- reg: specifies physical base address and size of the registers.
- clocks: enable EADC clock.
- eadc-frequency: specifies EADC frequency.

Example:

eadc: eadc@40430000 {
	compatible = "nuvoton,ma35d1-eadc";
	reg = <0x0 0x40430000 0x0 0x10000>;
	clocks = <&clk eadc_gate>;
	eadc-frequency = <20000000>;
	status = "okay";
};
```

## Documentation/devicetree/bindings/input/nvt,ma35d1-keypad.yaml
```yaml
# SPDX-License-Identifier: (GPL-2.0-only OR BSD-2-Clause)
%YAML 1.2
---
$id: http://devicetree.org/schemas/input/ma35d1-keypad.yaml#
$schema: http://devicetree.org/meta-schemas/core.yaml#

title: NVT MA35D1 Keypad device tree bindings

maintainers:
  - Liu Ying <gnuiyl@gmail.com>

allOf:
  - $ref: "/schemas/input/matrix-keymap.yaml#"

properties:
    compatible:
        - const: nuvoton,ma35d1-kpi

    debounce-period:
        $ref: /schemas/types.yaml#/definitions/uint32
        description: 
            key debounce period select
            0  = 0 clock
            1  = 0 clock
            2  = 0 clock
            3  = 8 clocks
            4  = 16 clocks
            5  = 32 clocks
            6  = 64 clocks
            7  = 128 clocks
            8  = 256 clocks
            9  = 512 clocks
            10 = 1024 clocks
            11 = 2048 clocks
            12 = 4096 clocks
            13 = 8192 clocks

    per-scale:
        $ref: /schemas/types.yaml#/definitions/uint32
        description:
            Row Scan Cycle Pre-scale Value. The number is from 1 to 256.

    per-scalediv:
        $ref: /schemas/types.yaml#/definitions/uint32
        description:
            Per-scale divider. The number is from 1 to 256.

    reg:
        maxItems: 1

    interrupts:
        maxItems: 1

    clocks:
        maxItems: 1

required:
  - compatible
  - reg
  - interrupts
  - clocks
  - linux,keymap
  - debounce-period
  - per-scale
  - per-scalediv

unevaluatedProperties: false

examples:
  - |
    keypad: keypad@404A0000 {
		compatible = "nuvoton,ma35d1-kpi";
		reg = <0x0 0x404A0000 0x0 0x10000>;
		interrupts = <GIC_SPI 79 IRQ_TYPE_LEVEL_HIGH>;
		clocks = <&clk KPI_GATE>;
		keypad,num-rows = <4>;
		keypad,num-columns = <4>;
		linux,keymap = <MATRIX_KEY(0x00, 0x02, KEY_F) /* key_forward */
		MATRIX_KEY(0x00, 0x03, KEY_HOME) /* key_home */
		MATRIX_KEY(0x01, 0x00, KEY_A) /* key_contacts */
		MATRIX_KEY(0x01, 0x01, KEY_1) /* key_1 */
		MATRIX_KEY(0x01, 0x02, KEY_2) /* key_2 */
		MATRIX_KEY(0x01, 0x03, KEY_3) /* key_3 */
		MATRIX_KEY(0x02, 0x00, KEY_P) /* key_phone */
		MATRIX_KEY(0x02, 0x01, KEY_4) /* key_4 */
		MATRIX_KEY(0x02, 0x02, KEY_5) /* key_5 */
		MATRIX_KEY(0x02, 0x03, KEY_6) /* key_6 */
		MATRIX_KEY(0x03, 0x00, KEY_C) /* key_call_log */
		MATRIX_KEY(0x03, 0x01, KEY_7) /* key_7 */
		MATRIX_KEY(0x03, 0x02, KEY_8) /* key_8 */
		MATRIX_KEY(0x03, 0x03, KEY_9) /* key_9 */
		>;

		debounce-period = <1>;
		per-scale = <1>;
		per-scalediv = <24>;

    };
```

## Documentation/devicetree/bindings/input/touchscreen/nuvoton,ma35d1-adc.txt
```
* Nuvoton MA35D1 touchscreen(ADC)

Required properties:
  - compatible: Should be "nuvoton,ma35d1-adc"
  - reg: Should contain ADC registers location and length
  - clock-rate: Between <16000000> ~ <1000000>
  - interrupts: Should contain the IRQ line for the ADC

Optional properties:
  - enable-iio: Set this to enable IIO function
  - enable-ts: Set this to enable touch screen function
  - ts-mode: Set touch screen type. <4> for 4-wire touch panel
		and <5> for 5-wire touch panel.
  - enable-wakeup: Set this to enable system wakeup by touch event.
  - ts-pressure-threshold: A pressure threshold for touchscreen to detect pen up event.

Examples:
adc: adc@0x40420000 {
	compatible = "nuvoton,ma35d1-adc";
	reg = <0x0 0x40420000 0x0 0x10000>;
	interrupts = <GIC_SPI 80 IRQ_TYPE_LEVEL_HIGH>;
	clock-rate = <16000000>;
	enable-iio;
	enable-ts;
	ts-type = <4>;
};
```

## Documentation/devicetree/bindings/mailbox/nuvoton,ma35d1-wormhole.txt
```
* Nuvoton MA35D1 Wormhole Controller

MA35D1 Wormhole Controller supports
a. 4 bi-direction channels (#0~#3) for data transfer with fix message size 4 words
b. 4 general interrupt channels (#4~#7) for sending sinal only
c. 1 status channel (#8) for detecting CM4 status power status change and reset event


Mailbox Device Node:
====================
Required properties:
- compatible:   Must be "nuvoton,ma35d1-wormhole"
- reg:          Register address range (base address and length)
- interrupts:   Interrupt specifiers for wormhole controller.
- #mbox-cells:  Number of cells required for the mailbox specifier. Must be 1.
                The data contained in the mbox specifier of the "mboxes"
                property in the client node is the mailbox channel index.

Optional properties:
- wakeup-source: Flag to indicate whether this device can wake up the system



Example:
	wormhole: mailbox@403A0000 {
		compatible = "nuvoton,ma35d1-wormhole";
		reg = <0x0 0x403A0000 0x0 0x1000>;
		interrupts = <GIC_SPI 4 IRQ_TYPE_LEVEL_HIGH>;
		wakeup-source;
		#mbox-cells = <1>;
		status = "okay";
	};


Mailbox client
===============
Required properties:
- mboxes:		Standard property to specify a Mailbox channel (See ./mailbox.txt)
			Cells must match 'mbox-cells' (See Mailbox Device Node above).

Example of client using channel 1 for Tx/Rx:
	wormhole_test: wormhole_test{
		...
		mboxes = <&wormhole 1>;
	};
```

## Documentation/devicetree/bindings/media/ma35d1-ccap.txt
```
Camera Capture Interface Controller (CCAP) 
========================

The camera capture interface controller(CCAP) is designed to 
capture image data from a sensor. After capturing or fetching image data, 
it will process the image data. 
And then embedded DMA controller will move 
the data from the internal FIFO to system memory with AHB bus.

Required properties:
- compatible: should be "nuvoton,<soc>-ccap", where SoC can be one of ma35d1
- reg: the register base and size for the device registers
- interrupts: the CCAP interrupt.

Example:

	ccap0: ccap@40240000{
		compatible = "nuvoton,ma35d1-ccap";
		reg = <0x0 0x40240000 0x0 0x2000>;
		interrupts = <GIC_SPI 21 IRQ_TYPE_LEVEL_HIGH>;
		clocks = <&clk ccap0_gate>;
		clock-names = "core";
		clock-frequency = <12000000>;
		status = "okay";
		port {
			#address-cells = <1>;
			#size-cells = <0>;

			/* Parallel bus endpoint */
			ccap0_1: endpoint {
				remote-endpoint = <&nt99141_0>;
				bus-type = <5>;  	/* 5:Parallel, 6:Bt.656 */ 
				bus-width = <8>;        /* Used data lines */
				hsync-active = <0>;     /* Active low */
				vsync-active = <0>;     /* Active low */
				pclk-sample = <1>;      /* Rising */
                        };
                };
	};

	i2c_gpio@0 {
		compatible = "i2c-gpio";
		gpios = <&gpio 3 0 /* sda */
 			 &gpio 4 0 /* scl */
			>;
		i2c-gpio,sda-open-drain;
		i2c-gpio,scl-open-drain;
		i2c-gpio,delay-us = <2>;	/* ~100 kHz */
		#address-cells = <1>;
		#size-cells = <0>;
		status = "okay";
		nt99141@2a {
			compatible = "nuvoton,nt99141";
			reg = <0x2a>;
			port {
                                nt99141_0: endpoint {
					remote-endpoint = <&ccap0_1>;
                                };
                        };
		};

	};

	ccap1: ccap@40250000{
		compatible = "nuvoton,ma35d1-ccap";
		reg = <0x0 0x40250000 0x0 0x2000>;
		interrupts = <GIC_SPI 22 IRQ_TYPE_LEVEL_HIGH>;
		clocks = <&clk ccap1_gate>;
		clock-names = "core";
		status = "okay";
        };
```

## Documentation/devicetree/bindings/media/ma35d1_vc8k.txt
```
* Nuvoton MA35D1 VC8K H264/JPEG decoder

The VC8K H264/JPEG decoder presented on Nuvoton MA35D1 SOC supports H264 baseline, main prfile,
and high profile bit stream decode. MA35D1 VC8K supports H264 decode up to 1920x1080 resolution,
and JPEG decode support up to 16000 x 16000.

Required properties:

- compatible : Should be "nuvoton,ma35d1-vc8k"
- reg : address and length of the register for the device.
- clocks: VC8K clock source
- interrupts: should contain VC8K interrupt number
- nuvoton,sys: phandle referencing a syscon
- memory-region: reserved memory for VC8K H264 reference buffers
- pp_out_enable: Global VC8K PP setting. 1: enable PP; 0: disable PP
- fb_width: the width of frame buffer
- fb_height: the height of frame buffer
- fb_fmt: the color format of frame buffer. It should be RGB888, RGB565, or YUV420.
- vid_max_width: Expect maximum width of PP output images.
- vid_max_height: Expect maximum width of PP output images.
- vid_max_instance: Expect maximum number of H264 decode instances presented at the same time
- vid_refbuf_cnt: Pre-allocate number of reference buffers for each H264 decode instance

Note 1:  VC8K kernel module tries to allocate enough reference buffers on module inserted.  
             vid_max_width and vid_max_height determines the size of each reference buffer.
             vid_max_instance and vid_refbuf_cnt determines the number of reference buffers to allocate.

Example:

	vc8k:vc8k@40290000 {
		compatible = "nuvoton,ma35d1-vc8k";
		reg = <0x0 0x40290000 0x0 0x1000>;
		clocks = <&clk vc8k_gate>;
		nuvoton,sys = <&sys>;
		interrupts = <GIC_SPI 28 IRQ_TYPE_LEVEL_HIGH>;
		memory-region = <&vc8k_buf>;
		pp_out_enable = "yes";
		fb_width = <1024>;
		fb_height = <600>;
		fb_fmt = "RGB888";   /* RGB888, RGB565, or YUV420P */
		vid_max_width = <1280>;
		vid_max_height = <720>;
		vid_max_instance = <3>;
		vid_refbuf_cnt = <6>;
		status = "okay";
	};
```

## Documentation/devicetree/bindings/mfd/nuvoton,ma35d1-sys.yaml
```yaml
# SPDX-License-Identifier: (GPL-2.0-only OR BSD-2-Clause)
%YAML 1.2
---
$id: http://devicetree.org/schemas/mfd/nuvoton,ma35d1-sys.yaml#
$schema: http://devicetree.org/meta-schemas/core.yaml#

title: Nuvoton MA35D1 System Management Device Tree Bindings

maintainers:
  - Chi-Fang Li <cfli0@nuvoton.com>
  - Jacky Huang <ychuang3@nuvoton.com>

description:
  This node provides the system register map reference for drivers
  of MA35D1 on-chip controllers/peripherals. The system registers
  include product identifier, power-on setting, reset control, pin
  multi-function control and miscellaneous function control.

properties:
  compatible:
    items:
      - enum:
          - nuvoton,ma35d1-sys
      - const: syscon
      - const: simple-mfd

  reg:
    maxItems: 1

required:
  - compatible
  - reg

additionalProperties: false

examples:
  # system management node:
  - |
    sys: system-management@40460000 {
        compatible = "nuvoton,ma35d1-sys", "syscon", "simple-mfd";
        reg = <0x0 0x40460000 0x0 0x200>;
    };
...
```

## Documentation/devicetree/bindings/mfd/nuvoton,ma35d1-sysctl.txt
```
* Device tree bindings for Nuvoton MA35D1 SYSCTL driver

The driver is used for Lock/Unlock protected registers.

Required properties:
- compatible:		"nuvoton,ma35d1-sysctrl"
- nuvoton,ma35d1-sys:	phandle referencing a syscon providing reset control register

Example:

	sysctl: sys-controller {
		compatible = "nuvoton,ma35d1-sysctrl";
		nuvoton,ma35d1-sys = <&sys>;
	};
```

## Documentation/devicetree/bindings/misc/ma35d1_ebi.txt
```
NUC3500 External Bus Interface(EBI)

This chip is equipped with an external bus interface for external device 
use. The EBI supports three chip selects that can connect three external 
devices with different timing setting requirements.

Required Properties of EBI:

- compatible : Should be "nuvoton,ma35d1-ebi"
- reg : address and length of the register for the device.
- bank: Bank number for EBI. Should be 0~2
- clock-enable: Enable EBI clock.
- busmode: EBI Address/Data Bus Separate Mode 1:Enable, 0:Disable.
- csactiveLevel: Chip Select Pin Polar Inverse. 0:active low, 1:active High
- datawidth: EBI data width is 0:8-bit or 1:16-bit
Configure EBI timing parameters includes MCLKDIV, tALE, tACC, tAHD and IDLE.
	- MCLKDIV:EBI output clock divide selection.(EBI_CTL0[10:8])
	- tALE:ALE High Period.(EBI_CTL0[18:16])
	- tACC:Data Access Time.(EBI_TCTLx[7:3])
	- tAHD:Data Access Hold Time.(EBI_TCTLx[10:9])
	- IDLE:Idle Cycle of Write command(W2X(EBI_TCTLx[27:24])) finish and 
		Idle of Read-to-Read(R2R(EBI_TCTLx[15:12]))

Example:

	ebi0: ebi@40100000 {
		compatible = "nuvoton,ma35d1-ebi";
		reg = <0x0 0x40100000 0x0 0x10>;
		bank = <0>;
		clock-enable = "ebi_gate";
		busmode = <1>;//Address/Data Bus Separate Mode. 0:Disabled, 1:Enabled
		csactiveLevel = <0>;//0:Low, 1: High
		datawidth = <1>;//0:8bit, 1: 16bit
		tALE = <1>;//0 ~ 7,EBI_CTL0[18:16]
		tACC = <1>;//0 ~ 31, EBI_TCTLx[7:3]
		tAHD = <1>;//0 ~ 7, EBI_TCTLx[10:9]
		IDLE  = <3>;//0 ~ 15, EBI_TCTLx[27:24] and EBI_TCTLx[15:12]
	};
```

## Documentation/devicetree/bindings/misc/ma35d1_ks.txt
```
* Nuvoton MA35D1 Key Store management controller

The Key Store presented on Nuvoton MA35D1 SOC is the key management device and has a 4 Kbytes SRAM
and 9 OTP entries for key storage.

Required properties:

- compatible : Should be "nuvoton,ma35d1-ks"
- reg : address and length of the register for the device.
- interrupts: should contain Key Store interrupt number
- optee_nuvoton: support KeyStore driver link to OP-TEE KS PTA.


Example:

        key_store: ks@40340800 {
		compatible = "nuvoton,ma35d1-ks";
		reg = <0x0 0x40340800 0x0 0x800>;
		interrupts = <GIC_SPI 41 IRQ_TYPE_LEVEL_HIGH>;
		optee_nuvoton = "no";
		status = "okay";
        };
```
