## Documentation/devicetree/bindings/clock/nuvoton,ma35d1-clk.txt
```
* Nuvoton MA35D1 Clock Controller

All available clocks are defined as preprocessor macros in:
dt-bindings/clock/ma35d1-clk.h
and can be reused as DT sources.

Required Properties of clock controller:

- compatible: Clock Controller should be "nuvoton,ma35d1-clk"
    - reg: physical base address of the clock controller and length of
    memory mapped region.
    - #clock-cells: Should be 1.
    - assigned-clocks: Should contain the following clock names:
    "capll", "syspll", "ddrpll", "apll", "epll", "vpll".
    - assigned-clock-rates: PLL output frequency.
    - clock-pll-mode: PLL Operation modes. Should be 0, 1 or 2.

    Optional Properties:

    - nuvoton, ma35d1-sys: phandle to the syscon managing the "System Management register".


    Example: Clock controller node:

    clk: clock-controller@40460200
	{
	compatible = "nuvoton,ma35d1-clk";
	reg = <0x00000000 0x40460200 0x0 0x100>;
	#clock-cells = <1>;
	assigned-clocks =<&clk capll>, <&clk syspll>,
	   	      <&clk ddrpll>, <&clk apll>,
	   	      <&clk epll>, <&clk vpll>;
	assigned-clock-rates =	<1000000000>, <189000000>,
	               <266000000>, <147456000>,
	               <500000000>, <533000000>;
	clock-pll-mode = <0>, <0>, <1>, <1>, <0>, <2>;
	nuvoton,sys = <&sys>;
};
```

## Documentation/devicetree/bindings/clock/nuvoton,ma35d1-clk.yaml
```yaml
# SPDX-License-Identifier: (GPL-2.0-only OR BSD-2-Clause)
%YAML 1.2
---
$id: http://devicetree.org/schemas/clock/nuvoton,ma35d1-clk.yaml#
$schema: http://devicetree.org/meta-schemas/core.yaml#

title: Nuvoton MA35D1 Clock Control Module Binding

maintainers:
  - Chi-Fang Li <cfli0@nuvoton.com>
  - Jacky Huang <ychuang3@nuvoton.com>

description: |
  The MA35D1 clock controller generates clocks for the whole chip,
  including system clocks and all peripheral clocks.

  See also:
    dt-bindings/clock/nuvoton,ma35d1-clk.h

properties:
  compatible:
    const: nuvoton,ma35d1-clk

  reg:
    maxItems: 1

  "#clock-cells":
    const: 1

  clocks:
    maxItems: 1

  assigned-clocks:
    maxItems: 4

  assigned-clock-rates:
    maxItems: 4

  clock-pll-mode:
    maxItems: 4

required:
  - compatible
  - reg
  - "#clock-cells"

additionalProperties: false

examples:
  # clock control module node:
  - |
    #include <dt-bindings/clock/nuvoton,ma35d1-clk.h>

    clk: clock-controller@40460200 {
        compatible = "nuvoton,ma35d1-clk";
        reg = <0x40460200 0x100>;
        #clock-cells = <1>;
    };
...
```

## Documentation/devicetree/bindings/crypto/nuvoton-crypto.txt
```
* Nuvoton MA35D1 Cryptographic Accelerator

The cryptographic accelerator presented on Nuvoton MA35D1 SOC supports AES ECB/CBC/OFB/CFB/CTR/GCM/CCM
encrypt/decrypt, SHA1/SHA2/SHA3/HMAC/SM3/MD5 hash, ECC ecdh, and RSA 1024/2408/3072/4096 bits encrypt/decrypt.

Required properties:

- compatible : Should be "nuvoton,ma35d1-crypto"
- reg : address and length of the register for the device.
- interrupts: should contain Crypto engine interrupt number
- optee_nuvoton: support crypto driver link to OP-TEE Crypto PTA.
- rsa_ctl: If "yes", RSA driver support ioctl interface, otherwise support akcipher.
- ecc_ctl: If "yes", ECC driver support ioctl interface, otherwise support akcipher.

Example:

        crypto: crpt@40300000 {
		compatible = "nuvoton,ma35d1-crypto";
		reg = <0x0 0x40300000 0x0 0x1000>;
		interrupts = <GIC_SPI 39 IRQ_TYPE_LEVEL_HIGH>;
		optee_nuvoton = "no";
		rsa_ioctl = "no";
		ecc_ioctl = "no";
		status = "okay";
        };
```

## Documentation/devicetree/bindings/display/nuvoton,ma35d1-fb.txt
```
MA35D1 Display Controller Framebuffer driver
-----------------------------------------------------

Required properties:
- compatible : "nuvoton,ma35d1-fb"
- reg : Address and length of the register set for display controller
- interrupts : Display controller interrupt of the fb dev
- clocks : The first dcu_gate is the display cotroller core clock.
			The second dcup_div is the display cotroller pixel clock.
			Should be "clk dcu_gate" and "clk dcup_div"
- resets : Display controller reset source.
			Should be "reset MA35D1_RESET_DISP"

- reset_offset_en : Reset on-screen buffer address offset to fb_release.
			The default value is "no".

- bits-per-pixel : Bits per Input pixel(16 or 32)
- pixel-fmt : Input Formats (4:RGB565, 6:ARGB8, 8:UYVY, 17:NV12)
- bus-width : Output width. Should be "24"

- buffer-num : The amount of framebuffer for reserved memory. 
- colorkey-en : Enable colorkey function.

- overlay-en : Enable Overlay layer.
- overlay-pixel-fmt : Overlay Input Format. Should be "6"(ARGB8)
- overlay-width : Overlay width.
- overlay-height : Overlay height.
- overlay-rect-tlx : Left boundary of overlay window.
- overlay-rect-tly : Top boundary of overlay window.

Required subnodes:
- "display-timing" containing video timings
  (Documentation/devicetree/bindings/display/panel/display-timing.txt)

Example:

	display: display@40260000 {
		compatible = "nuvoton,ma35d1-fb";
		reg = <0x0 0x40260000 0x0 0x2000>;
		interrupts = <GIC_SPI 20 IRQ_TYPE_LEVEL_HIGH>;
		clocks = <&clk dcu_gate>, <&clk dcup_div>;
		status = "disabled";
		resets = <&reset MA35D1_RESET_DISP>;

		bits-per-pixel = <32>;
		pixel-fmt = <6>;
		bus-width = <24>;

		buffer-num = <3>;
		colorkey-en = <1>;

		overlay-en = <1>;
		overlay-pixel-fmt = <6>;
		overlay-width = <512>;
		overlay-height = <300>;
		overlay-rect-tlx = <0>;
		overlay-rect-tly = <300>;

		display-timings {
			native-mode = <&timing0>;

			timing0: 1024x600 {
				clock-frequency = <51000000>;
				hactive = <1024>;
				vactive = <600>;
				hsync-len = <1>;
				hfront-porch = <160>;
				hback-porch = <160>;
				vsync-len = <1>;
				vfront-porch  = <23>;
				vback-porch = <12>;
			};

		};
	};
```

## Documentation/devicetree/bindings/dma/ma35d1-pdma.txt
```
* Nuvoton MA35D1 PDMA Controller

Required properties:
- compatible should contain:
  * "nuvoton,ma35d1-pdma" for ma35d1 compatible PDMA

- reg: The base address of the PDMA register bank.

- interrupts: A single interrupt specifier.
 One interrupt per dma-requests, or 10 if no dma-requests property is present

- dma-requests: The number of DMA channels


Examples:


        pdma0: pdma@40080000 {
                compatible = "nuvoton,ma35d1-pdma";
                reg = <0x0 0x40080000 0x0 0x2000>;
                interrupts = <GIC_SPI 18 IRQ_TYPE_LEVEL_HIGH>;
                #dma-cells = <1>;
                #dma-channels = <10>;
                #dma-requests = <32>;
                status = "okay";
        };
        pdma1: pdma@40090000 {
                compatible = "nuvoton,ma35d1-pdma";
                reg = <0x0 0x40090000 0x0 0x2000>;
                interrupts = <GIC_SPI 19 IRQ_TYPE_LEVEL_HIGH>;
                #dma-cells = <1>;
                #dma-channels = <10>;
                status = "disabled";
        };
        pdma2: pdma@400A0000 {
                compatible = "nuvoton,ma35d1-pdma";
                reg = <0x0 0x400A0000 0x0 0x2000>;
                interrupts = <GIC_SPI 42 IRQ_TYPE_LEVEL_HIGH>;
                #dma-cells = <1>;
                #dma-channels = <10>;
                status = "disabled";
        };
        pdma3: pdma@400B0000 {
                compatible = "nuvoton,ma35d1-pdma";
                reg = <0x0 0x400B0000 0x0 0x2000>;
                interrupts = <GIC_SPI 43 IRQ_TYPE_LEVEL_HIGH>;
                #dma-cells = <1>;
                #dma-channels = <10>;
                status = "disabled";
        };
```

## Documentation/devicetree/bindings/dma/nuvoton,ma35d1-dma.yaml
```yaml
# SPDX-License-Identifier: (GPL-2.0-only OR BSD-2-Clause)
%YAML 1.2
---
$id: http://devicetree.org/schemas/dma/nuvoton,ma35d1-dma.yaml#
$schema: http://devicetree.org/meta-schemas/core.yaml#

title: Nuvoton MA35D1 DMA controller

description: |
  This describes the devicetree bindings for four Peripheral DMA engine to perform
  memory-to-memory or peripheral-to-memory data transfer capable of supporting
  10 channels, implemented in Nuvoton MA35D1 SoCs.

maintainers:
  - Shan-Chun Hung <schung@Nuvoton.com>

allOf:
  - $ref: "dma-controller.yaml#"

properties:
  compatible:
    const: nuvoton,ma35d1-dma

  reg:
    maxItems: 1

  clocks:
    maxItems: 1
    
  interrupts:
    maxItems: 1

  "#dma-cells":
    const: 1

  dma-channels:
    minimum: 1
    maximum: 10

additionalProperties: false

required:
  - compatible
  - reg
  - clocks
  - interrupts
  - "#dma-cells"
  - dma-channels

examples:
  - |
    pdma0: dma-controller@40080000 {
        compatible = "nuvoton,ma35d1-dma";
        reg = <0x0 0x40080000 0x0 0x2000>;
        interrupts = <GIC_SPI 18 IRQ_TYPE_LEVEL_HIGH>;
        clocks = <&clk PDMA0_GATE>;
        #dma-cells = <1>;
        dma-channels = <10>;
    };
```

## Documentation/devicetree/bindings/gpio/gpio-ma35d1.txt
```
Nuvootn MA35D1 GPIO controller Device Tree Bindings
-------------------------------------------

Required properties:
- #gpio-cells           : Should be two
                          - First cell is the GPIO line number
                          - Second cell is used to specify optional
                            parameters (unused)
- compatible            : Should be "nuvoton,ma35d1-gpio"
- gpio-controller       : Marks the device node as a GPIO controller.
- interrupts            : Interrupt specifier (see interrupt bindings for
                          details)
- clocks		: gpa_gate ~ gpn_gate clocks.
- interrupt-controller  : Marks the device node as an interrupt controller.
- #interrupt-cells      : Should be 2.  The first cell is the GPIO number.
                          The second cell bits[3:0] is used to specify trigger type and level flags:
                              1 = low-to-high edge triggered.
                              2 = high-to-low edge triggered.
                              4 = active high level-sensitive.
                              8 = active low level-sensitive.
- reg                   : Address and length of the register set for the device

Example:

	gpioa: gpioa@40040000 {
		compatible = "nuvoton,ma35d1-gpio";
		reg =	<0x0 0x40040000 0 0x40>,
			<0x0 0x40040800 0 0x40>;
		interrupts =	<GIC_SPI  14 IRQ_TYPE_LEVEL_HIGH>;
		clocks =	<&clk gpa_gate>;
		#gpio-cells = <2>;
		gpio-controller;
		interrupt-controller;
		#interrupt-cells = <2>;
		status = "okay";
	};
	gpiob: gpiob@40040040 {
		compatible = "nuvoton,ma35d1-gpio";
		reg =	<0x0 0x40040040 0 0x40>,
			<0x0 0x40040840 0 0x40>;
		interrupts =	<GIC_SPI  15 IRQ_TYPE_LEVEL_HIGH>;
		clocks =	<&clk gpb_gate>;
		#gpio-cells = <2>;
		gpio-controller;
		interrupt-controller;
		#interrupt-cells = <2>;
		status = "okay";
	};
	gpioc: gpioc@40040080 {
		compatible = "nuvoton,ma35d1-gpio";
		reg =	<0x0 0x40040080 0 0x40>,
			<0x0 0x40040880 0 0x40>;
		interrupts =	<GIC_SPI  16 IRQ_TYPE_LEVEL_HIGH>;
		clocks =	<&clk gpc_gate>;
		#gpio-cells = <2>;
		gpio-controller;
		interrupt-controller;
		#interrupt-cells = <2>;
		status = "okay";
	};
	gpiod: gpiod@400400c0 {
		compatible = "nuvoton,ma35d1-gpio";
		reg =	<0x0 0x400400C0 0 0x40>,
			<0x0 0x400408C0 0 0x40>;
		interrupts =	<GIC_SPI  17 IRQ_TYPE_LEVEL_HIGH>;
		clocks =	<&clk gpd_gate>;
		#gpio-cells = <2>;
		gpio-controller;
		interrupt-controller;
		#interrupt-cells = <2>;
		status = "okay";
	};
	gpioe: gpioe@40040100 {
		compatible = "nuvoton,ma35d1-gpio";
		reg =	<0x0 0x40040100 0 0x40>,
			<0x0 0x40040900 0 0x40>;
		interrupts =	<GIC_SPI  73 IRQ_TYPE_LEVEL_HIGH>;
		clocks =	<&clk gpe_gate>;
		#gpio-cells = <2>;
		gpio-controller;
		interrupt-controller;
		#interrupt-cells = <2>;
		status = "okay";
	};
	gpiof: gpiof@40040140 {
		compatible = "nuvoton,ma35d1-gpio";
		reg =	<0x0 0x40040140 0 0x40>,
			<0x0 0x40040940 0 0x40>;
		interrupts =	<GIC_SPI  74 IRQ_TYPE_LEVEL_HIGH>;
		clocks =	<&clk gpf_gate>;
		#gpio-cells = <2>;
		gpio-controller;
		interrupt-controller;
		#interrupt-cells = <2>;
		status = "okay";
	};
	gpiog: gpiog@40040180 {
		compatible = "nuvoton,ma35d1-gpio";
		reg =	<0x0 0x40040180 0 0x40>,
			<0x0 0x40040980 0 0x40>;
		interrupts =	<GIC_SPI  75 IRQ_TYPE_LEVEL_HIGH>;
		clocks =	<&clk gpg_gate>;
		#gpio-cells = <2>;
		gpio-controller;
		interrupt-controller;
		#interrupt-cells = <2>;
		status = "okay";
	};
	gpioh: gpioh@400401C0 {
		compatible = "nuvoton,ma35d1-gpio";
		reg =	<0x0 0x400401C0 0 0x40>,
			<0x0 0x400409C0 0 0x40>;
		interrupts =	<GIC_SPI  76 IRQ_TYPE_LEVEL_HIGH>;
		clocks =	<&clk gph_gate>;
		#gpio-cells = <2>;
		gpio-controller;
		interrupt-controller;
		#interrupt-cells = <2>;
		status = "okay";
	};
	gpioi: gpioi@40040200 {
		compatible = "nuvoton,ma35d1-gpio";
		reg =	<0x0 0x40040200 0 0x40>,
			<0x0 0x40040A00 0 0x40>;
		interrupts =	<GIC_SPI  77 IRQ_TYPE_LEVEL_HIGH>;
		clocks =	<&clk gpi_gate>;
		#gpio-cells = <2>;
		gpio-controller;
		interrupt-controller;
		#interrupt-cells = <2>;
		status = "okay";
	};
	gpioj: gpioj@40040240 {
		compatible = "nuvoton,ma35d1-gpio";
		reg =	<0x0 0x40040240 0 0x40>,
			<0x0 0x40040A40 0 0x40>;
		interrupts =	<GIC_SPI  78 IRQ_TYPE_LEVEL_HIGH>;
		clocks =	<&clk gpj_gate>;
		#gpio-cells = <2>;
		gpio-controller;
		interrupt-controller;
		#interrupt-cells = <2>;
		status = "okay";
	};
	gpiok: gpiok@40040280 {
		compatible = "nuvoton,ma35d1-gpio";
		reg =	<0x0 0x40040280 0 0x40>,
			<0x0 0x40040A80 0 0x40>;
		interrupts =	<GIC_SPI  102 IRQ_TYPE_LEVEL_HIGH>;
		clocks =	<&clk gpk_gate>;
		#gpio-cells = <2>;
		gpio-controller;
		interrupt-controller;
		#interrupt-cells = <2>;
		status = "okay";
	};
	gpiol: gpiol@400402C0 {
		compatible = "nuvoton,ma35d1-gpio";
		reg =	<0x0 0x400402C0 0 0x40>,
			<0x0 0x40040AC0 0 0x40>;
		interrupts =	<GIC_SPI  103 IRQ_TYPE_LEVEL_HIGH>;
		clocks =	<&clk gpl_gate>;
		#gpio-cells = <2>;
		gpio-controller;
		interrupt-controller;
		#interrupt-cells = <2>;
		status = "okay";
	};
	gpiom: gpiom@40040300 {
		compatible = "nuvoton,ma35d1-gpio";
		reg =	<0x0 0x40040300 0 0x40>,
			<0x0 0x40040B00 0 0x40>;
		interrupts =	<GIC_SPI  104 IRQ_TYPE_LEVEL_HIGH>;
		clocks =	<&clk gpm_gate>;
		#gpio-cells = <2>;
		gpio-controller;
		interrupt-controller;
		#interrupt-cells = <2>;
		status = "okay";
	};
	gpion: gpion@40040340 {
		compatible = "nuvoton,ma35d1-gpio";
		reg =	<0x0 0x40040340 0 0x40>,
			<0x0 0x40040B40 0 0x40>;
		interrupts =	<GIC_SPI  105 IRQ_TYPE_LEVEL_HIGH>;
		clocks =	<&clk gpn_gate>;
		#gpio-cells = <2>;
		gpio-controller;
		interrupt-controller;
		#interrupt-cells = <2>;
		status = "okay";
	};
	gpio_keys_test { 
		compatible = "gpio-keys";
		autorepeat;
		botton0 { 
			label = "GPA1 Key Down";
			linux,code = <116>;
			gpios = <&gpioa 1 GPIO_ACTIVE_HIGH>;
			wakeup-source;
		};
		button1{
			label ="GPD1 Key Up";
			linux,code = <117>;
			gpios = <&gpiod 1 GPIO_ACTIVE_LOW>;
			wakeup-source;
		};
	};

	gpio_leds_test {
		compatible = "gpio-leds";
		led0 {
			label = "GPA2 LED";
			gpios = <&gpioa 2 GPIO_ACTIVE_LOW>;
		};
		led1 {
			label = "GPD2 LED";
			gpios = <&gpiod 2 GPIO_ACTIVE_HIGH>;
		};
	};
```

## Documentation/devicetree/bindings/hwlock/nuvoton,ma35d1-hwsem.txt
```
Nuvoton MA35D1 Hardware Semaphore Device Binding
-------------------------------------

Required properties :
- compatible : should be "nuvoton,ma35d1-hwsem".
- reg : the register address of hwspinlock.

Please look at the generic hwlock binding for usage information for consumers,
"Documentation/devicetree/bindings/hwlock/hwlock.txt"

Example of hwlock provider:
	hwsem: hwspinlock@40380000 {
		compatible = "nuvoton,ma35d1-hwsem";
		reg = <0x0 0x40380000 0x0 0x1000>;
		status = "okay";
	};
```
