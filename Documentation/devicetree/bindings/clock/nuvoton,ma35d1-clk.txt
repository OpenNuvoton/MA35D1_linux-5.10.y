## Documentation/devicetree/bindings/misc/ma35d1_timer.txt
```
* NUC3500 Timer controller

The Timer controller includes 24-bit Timer0 ~ Timer11.
The Timer controller can perform functions, such as frequency measurement, delay timing, clock generation,
    and event counting by external input pins, and interval measurement by external capture pins.

    Required Properties of Timer controller:

    - compatible : Should be "nuvoton,ma35d1-timer"
    - reg : address and length of the register for the device.
    - interrupts:  Should contain Timer interrupt number
    - port-number:  Timer port number. Should be 0~11
    - nuvoton,clk: phandle to the syscon managing the "Clock Controller register".
    - clock-enable: Enable Timer clock.
    - clock-names: Control the mux to select Timer clock source.

    Example:

	timer2: timer_pwm2@40510000
	{
		compatible = "nuvoton,ma35d1-timer";
		reg = <0x0 0x40510000 0x0 0x100>;
		interrupts = <GIC_SPI 49 IRQ_TYPE_LEVEL_HIGH>;
		port-number = <2>;
		nuvoton,clk = <&clk>;
		clock-enable = "tmr2_gate";
		clock-names = "tmr2_mux";
		status = "okay";
	};
```

## Documentation/devicetree/bindings/mmc/sdhci-of-ma35d1.txt
```
* Synopsys DesignWare Cores Mobile Storage Host Controller

Required properties:
- compatible: should be one of the following:
    "nuvoton,ma35d1-sdhci"
- reg: offset and length of the register set for the device.
- interrupts: a single interrupt specifier.
- clocks: Array of clocks required for SDHCI; requires at least one for
    core clock.
- clock-names: Array of names corresponding to clocks property; shall be
    "core" for core clock and "bus" for optional bus clock.

Example:
	sdhci0: sdhci@40180000 {
		compatible = "nuvoton,ma35d1-sdhci";
 		reg = <0x0 0x40180000 0x0 0x2000>;
 		interrupts = <GIC_SPI 30 IRQ_TYPE_LEVEL_HIGH>;
   		clocks = <&clk sdh0_gate>;
 		clock-names = "core";
  		bus-width = <4>;
 		max-frequency = <100000000>;
  		dhci-caps-mask = <0x4 0x0>;  /* No support DDR50 mode */
  		no-1-8-v;
 		cd-gpios = <&gpioc 6 GPIO_ACTIVE_LOW>;
  		wp-gpios = <&gpioc 7 GPIO_ACTIVE_HIGH>;
  		status = "disabled";
 		assigned-clocks = <&clk sdh0_mux>;
		assigned-clock-parents = <&clk syspll>;
        };

	sdhci1:sdhci@40190000 {
		compatible = "nuvoton,ma35d1-sdhci";
		nuvoton,ma35d1-sys = <&sys>;
		reg = <0x0 0x40190000 0x0 0x2000>;
		interrupts = <GIC_SPI 31 IRQ_TYPE_LEVEL_HIGH>;
		resets = <&reset MA35D1_RESET_SDH1>;
		clocks = <&clk sdh1_gate>;
		clock-names = "core";
		bus-width = <8>;
		max-frequency = <200000000>;
		sdhci-caps-mask = <0x4 0x0>;  /* No support DDR50 mode */
		status = "disabled";
		cd-gpios = <&gpioj 5 GPIO_ACTIVE_LOW>;
		wp-gpios = <&gpioj 4 GPIO_ACTIVE_LOW>;
		assigned-clocks = <&clk sdh1_mux>;
		assigned-clock-parents = <&clk apll>;
        };
```

## Documentation/devicetree/bindings/mtd/ma35d1-nand.txt
```
Nuvoton MA35D1 NAND Flash Interface (NFI) controller DT binding

Required properties:

- compatible: "nuvoton,ma35d1-nand"
- reg: address range of the nand block
- interrupts: irq to be used
- sys: reference to the system register
- clk: reference to the system clock

- nand-ecc-mode: support hw oob first mode.
- nand-bus-width: support 8-bit
- nand-on-flash-bbt: see nand-controller.yaml

Optional properties:

- nand-ecc-strength:   Number of bits to correct per ECC step.
- nand-ecc-step-size:  Number of data bytes covered by a single ECC step.

Flash chip may optionally contain additional sub-nodes describing partitions of
the address space. See partition.txt for more detail.

Example:

	nand:nand@401A0000 {
		compatible = "nuvoton,ma35d1-nand";
		reg = <0x0 0x401A0000 0x0 0x1000>;
		interrupts = <GIC_SPI 38 IRQ_TYPE_LEVEL_HIGH>;	/* 70-32 */
		nuvoton,sys = <&sys>;
		nuvoton,clk = <&clk>;
		clock-enable = "nand_gate";
		nand-ecc-mode = "hw_oob_first";
		nand-ecc-algo = "bch";
		nand-bus-width = <8>;
		nand-ecc-strength = <8>;
		nand-ecc-step-size = <512>;
		nand-on-flash-bbt;

		partitions {
			compatible = "fixed-partitions";
			#address-cells = <1>;
			#size-cells = <1>;

			uboot@0 {
				label = "uboot";
				reg = <0x0000000 0x100000>;
				read-only;
			};

			...

	};
```

## Documentation/devicetree/bindings/mtd/ma35d1-nand.yaml
```yaml
# SPDX-License-Identifier: (GPL-2.0-only OR BSD-2-Clause)
%YAML 1.2
---
$id: http://devicetree.org/schemas/mtd/ma35d1-nand.yaml#
$schema: http://devicetree.org/meta-schemas/core.yaml#

title: Nuvoton MA35D1 NAND Flash Interface (NFI) controller DT binding

maintainers:
  - HPChen <hpchen0@nuvoton.com>

description: |
  The MA35D1 nand controller provides an interface to control the NAND
  flash chips. The device tree may optionally contain sub-nodes
  describing partitions of the address space. See partition.txt for
  more detail.

allOf:
  - $ref: "nand-controller.yaml"

properties:
  compatible:
    items:
      - enum:
          - nuvoton,ma35d1-nand

  reg:
    maxItems: 1

  interrupts:
    maxItems: 1

  clocks:
    maxItems: 1
    description: NAND Controller clock

  clock-names:
    const: nand_gate

patternProperties:
  "^nand@[a-f0-9]$":
    type: object
    properties:
      nand-ecc-step-size:
        enum: [512, 1024]

      nand-ecc-strength:
        enum: [8, 12, 24]


required:
  - compatible
  - reg
  - interrupts
  - clock-names
  - clocks

unevaluatedProperties: false

examples:
  - |
    nand:nand@401A0000 {
        compatible = "nuvoton,ma35d1-nand";
        reg = <0x0 0x401A0000 0x0 0x1000>;
        interrupts = <GIC_SPI 38 IRQ_TYPE_LEVEL_HIGH>;
        nuvoton,sys = <&sys>;
        nuvoton,clk = <&clk>;
        clock-enable = "nand_gate";
        clocks = <&clk NAND_GATE>;
        clock-names = "nand_gate";

        nand-ecc-mode = "hw_oob_first";
        nand-ecc-algo = "bch";
        nand-bus-width = <8>;
        nand-ecc-strength = <8>;
        nand-ecc-step-size = <512>;
        nand-on-flash-bbt;

        partitions {
            compatible = "fixed-partitions";
            #address-cells = <1>;
            #size-cells = <1>;

            uboot@0 {
                label = "nand-uboot";
                reg = <0x0000000 0x300000>;
                read-only;
            };
        };
    };

...
```

## Documentation/devicetree/bindings/net/nuvoton,ma35d1-gmac.txt
```
Nuvoton MA35D1 GMAC driver

Required properties:
- compatible: "nuvoton,ma35d1-gmac"
- reg: Address and length of the register set for the device
- interrupts: Should contain the EMAC interrupts
- interrupt-names: Should contain the interrupt names "macirq".
- nuvoton,ma35d1-sys: phandle to the syscon setting for gmac.
- clocks: First entry is the GMAC engine clock, and the second entry
	is <&clk epll_div8> for PTP clock.
- clock-names: Should be "stmmaceth" and "ptp_ref".
- resets: = Should contain the reset source of GMAC
- reset-names: Always "stmmaceth";
- clk_scr: Defines the MDIO clock rate, should set to 4.
- mac-id: Ether 0 or 1 depends on the GMAC instance
- phy-mode: see ethernet.txt [1].
- phy-handle: see ethernet.txt [1].

The MAC address will be determined using the properties defined in
ethernet.txt[1].

- PHY subnode: inherits from phy binding [2]

[1] Documentation/devicetree/bindings/net/ethernet.txt
[2] Documentation/devicetree/bindings/net/phy.txt

Examples:

gmac0: ethernet@40120000 {
	compatible = "nuvoton,ma35d1-gmac";
	reg = <0x0 0x40120000 0x0 0x10000>;
	interrupts = <GIC_SPI 23 IRQ_TYPE_LEVEL_HIGH>;
	interrupt-names = "macirq";
	mac-address = [ 00 11 22 33 44 55 ];
	nuvoton,ma35d1-sys = <&sys>;
	clocks = <&clk emac0_gate>, <&clk epll_div8>;
	clock-names = "stmmaceth", "ptp_ref";
	resets = <&reset MA35D1_RESET_GMAC0>;
	reset-names = "stmmaceth";
	mac-id = <0>;
	clk_csr = <4>;
	status = "okay";

	phy-mode = "rgmii-id";
	phy-handle = <&eth_phy0>;
	mdio0 {
		compatible = "snps,dwmac-mdio";
		#address-cells = <1>;
		#size-cells = <0>;

		eth_phy0: ethernet-phy@0 {
			reg = <1>;
		};
	};
};
```
