## Documentation/devicetree/bindings/spi/spi-ma35d1-qspi.txt
```
* Nuvoton MA35D1 QSPI Controller

The Nuvoton MA35D1 has 2 QSPI controllers that supports Quad mode transfer.

Required Properties:

- compatible: should be "nuvoton,nu3500-qspi"
- reg: physical base address of the controller and length of memory mapped
	region.
- interrupts: The interrupt number to the cpu. The interrupt specifier format
	depends on the interrupt controller.
- clocks: clock-names of QSPI.
- num_cs: number of chip select.
- lsb: lsb first.
- txneg: tx on falling edge.
- clkpol: clock polarity when idle.
- rxneg: rx on falling edge.
- sleep: suspend interval between two successive transmit/receive transaction
	in a transfer.
- txbitlen: tx bit length.
- quad: support Quad mode.
- bus_num: bus number.


Example: including SPI NOR and NAND 
	qspi0: qspi0@40680000 {
		compatible = "nuvoton,nu3500-qspi";
		reg = <0x0 0x40680000 0x0 0x10000>;
		interrupts = <GIC_SPI 57 IRQ_TYPE_LEVEL_HIGH>;
		clocks = <&clk qspi0_gate>;
		num_cs = <2>;
		lsb = <0>;
		txneg = <1>;
		clkpol = <0>;
		rxneg = <0>;
		sleep = <0>;
		txbitlen = <8>;
		quad = <0>;
		bus_num = <0>;
		status = "ok";

		flash@0 {
			#address-cells = <1>;
			#size-cells = <1>;
			compatible = "winbond,w25q128";
			spi-max-frequency = <10000000>;
			reg = <0 0x0 0x2000000>;

			partition@0 {
				label = "U-Boot";
				reg = <0x0 0x40000>;
			};
			partition@40000 {
				label = "Linux";
				reg = <0x40000 0x40000>;
			};
			partition@80000 {
				label = "Rootfs";
				reg = <0x80000 0x40000>;
			};
		};

	};

	qspi1: qspi1@40690000 {
		compatible = "nuvoton,nu3500-qspi";
		reg = <0x0 0x40690000 0x0 0x10000>;
		interrupts = <GIC_SPI 58 IRQ_TYPE_LEVEL_HIGH>;
		clocks = <&clk qspi1_gate>;
		num_cs = <2>;
		lsb = <0>;
		txneg = <1>;
		clkpol = <0>;
		rxneg = <0>;
		sleep = <0>;
		txbitlen = <8>;
		quad = <0>;
		bus_num = <1>;
		status = "disabled";

		flash: flash@0 {
			#address-cells = <1>;
			#size-cells = <1>;
			compatible = "spi-nand";
			reg = <0>;
			spi-max-frequency = <10000000>;

			partition@0 {
				label = "U-Boot";
				reg = <0x0 0x100000>;
			};
			partition@100000 {
				label = "Linux";
				reg = <0x100000 0x200000>;
			};
			partition@30000 {
				label = "Rootfs";
				reg = <0x300000 0x300000>;
			};
		};
	};
```

## Documentation/devicetree/bindings/spi/spi-ma35d1-spi.txt
```
* Nuvoton MA35D1 SPI Controller

The Nuvoton MA35D1 has 4 SPI controllers.

Required Properties:

- compatible: should be "nuvoton,nu3500-spi"
- reg: physical base address of the controller and length of memory mapped
	region.
- interrupts: The interrupt number to the cpu. The interrupt specifier format
	depends on the interrupt controller.
- clocks: clock-names of QSPI.
- num_cs: number of chip select.
- lsb: lsb first.
- txneg: tx on falling edge.
- clkpol: clock polarity when idle.
- rxneg: rx on falling edge.
- sleep: suspend interval between two successive transmit/receive transaction
	in a transfer.
- txbitlen: tx bit length.
- bus_num: bus number.


Example: 
	spi0: spi0@40600000 {
		compatible = "nuvoton,nu3500-spi";
		reg = <0x0 0x40600000 0x0 0x10000>;
		interrupts = <GIC_SPI 89 IRQ_TYPE_LEVEL_HIGH>;
		clocks = <&clk spi0_gate>;
		num_cs = <2>;
		lsb = <0>;
		txneg = <1>;
		clkpol = <0>;
		rxneg = <0>;
		sleep = <0>;
		txbitlen = <8>;
		bus_num = <2>;
		spi-max-frequency = <10000000>;
		status = "ok";
	};
```

## Documentation/devicetree/bindings/thermal/nuvoton,ma35d1-tsen.txt
```
Binding for Tmperature Sensor for Nuvoton MA35D1.


Required parameters:
-------------------

compatible: 		Should be "nuvoton,ma35d1-tsen"
#thermal-sensor-cells:	Should be 0. See ./thermal.txt for a description.
nuvoton,ma35d1-sys"	Phandle to the syscon used to access temperature sensor register

Example:

tsen: tsen {
	compatible = "nuvoton,ma35d1-tsen";
	#thermal-sensor-cells = <0>;
	nuvoton,ma35d1-sys = <&sys>;
	status = "okay";
};

thermal-zones {
	cpu_thermal: cpu-thermal {
		polling-delay-passive = <0>;
		polling-delay = <0>;
		thermal-sensors = <&tsen>;

		trips {
		};

		cooling-maps {
		};
	};
};
```

## Documentation/devicetree/bindings/usb/ma35d1-usb.txt
```
* NUC3500 USB EHCI host controller

Nuvoton MA35D1 SOC have two independent one-port EHCI host controllers, EHCI0 and EHCI1. 
Each EHCI controller has a companion OHCI host controller, i.e. OHCI0 and OHCI1. 


*******************************************************************************

EHCI0 Required properties:

- compatible : Should be "nuvoton,ma35d1-ehci0"
- reg : address and length of the register for the device.
- interrupts: should contain EHCI0 interrupt number
- clocks: EHCI0 clock source
- nuvoton,sys: phandle referencing a syscon

Example:

	ehci0: ehci@40140000 {
		compatible = "nuvoton,ma35d1-ehci0";
		reg = <0x0 0x40140000 0x0 0x1000>;
		clocks = <&clk husbh0_gate>;
		nuvoton,sys = <&sys>;
		interrupts = <GIC_SPI 33 IRQ_TYPE_LEVEL_HIGH>;
		status = "okay";
	};

*******************************************************************************

EHCI1 Required properties:

- compatible : Should be "nuvoton,ma35d1-ehci1"
- reg : address and length of the register for the device.
- interrupts: should contain EHCI1 interrupt number
- clocks: EHCI1 clock source
- nuvoton,sys: phandle referencing a syscon

Example:

	ehci1:ehci@401C0000 {
		compatible = "nuvoton,ma35d1-ehci1";
		reg = <0x0 0x401C0000 0x0 0x1000>;
		clocks = <&clk husbh1_gate>;
		nuvoton,sys = <&sys>;
		interrupts = <GIC_SPI 34 IRQ_TYPE_LEVEL_HIGH>;
		status = "okay";
	};


*******************************************************************************

OHCI0 Required properties:

- compatible : Should be "nuvoton,ma35d1-ohci0"
- reg : address and length of the register for the device.
- interrupts: should contain OHCI0 interrupt number
- clocks: OHCI0 clock source
- nuvoton,sys: phandle referencing a syscon

Example:

	ohci0:ohci@40150000 {
		compatible = "nuvoton,ma35d1-ohci0";
		reg = <0x0 0x40150000 0x0 0x1000>;
		clocks = <&clk husbh0_gate>;
		nuvoton,sys = <&sys>;
		interrupts = <GIC_SPI 35 IRQ_TYPE_LEVEL_HIGH>;
		status = "okay";
	};

*******************************************************************************

OHCI1 Required properties:

- compatible : Should be "nuvoton,ma35d1-ohci1"
- reg : address and length of the register for the device.
- interrupts: should contain OHCI1 interrupt number
- clocks: OHCI1 clock source
- nuvoton,sys: phandle referencing a syscon

Example:

	ohci1:ohci@401D0000 {
		compatible = "nuvoton,ma35d1-ohci1";
		reg = <0x0 0x401D0000 0x0 0x1000>;
		clocks = <&clk husbh1_gate>;
		nuvoton,sys = <&sys>;
		interrupts = <GIC_SPI 36 IRQ_TYPE_LEVEL_HIGH>;
		status = "okay";
	};

*******************************************************************************
```

## Documentation/devicetree/bindings/watchdog/nuvoton,ma35d1-wdt.txt
```
Nuvoton Watchdog

The watchdog supports a pre-timeout interrupt that fires 10ms before the
expiry.

Required properties:
- compatible      : must be "nuvoton,ma35d1-wdt"
- reg             : Offset and length of the register set for the device.
- interrupts      : Contain the timer interrupt with flags for
                    falling edge.

Required clocking property, have to be one of:
- clk             : reference to the system clock

Optional properties:
- timeout-sec : Contains the watchdog timeout in seconds

Example:

	wdt1: wdt@40400000 {
		compatible = "nuvoton,ma35d1-wdt";
		reg = <0x0 0x40440000 0x0 0x100>;
		interrupts = <GIC_SPI 43 IRQ_TYPE_LEVEL_HIGH>;	/* 75-32 */
		nuvoton,clk = <&clk>;
		clock-enable = "wdt1_gate";
		clock-names = "wdt1_mux";
	};
```

## Documentation/devicetree/bindings/watchdog/nuvoton,ma35d1-wwdt.txt
```
Nuvoton Window Watchdog

The window watchdog supports a pre-timeout interrupt that fires 10ms before the
expiry.

Required properties:
- compatible      : must be "nuvoton,ma35d1-wwdt"
- reg             : Offset and length of the register set for the device.
- interrupts      : Contain the timer interrupt with flags for
                    falling edge.

Required clocking property, have to be one of:
- clk             : reference to the system clock


Example:

	wwdt1: wwdt@40400100 {
		compatible = "nuvoton,ma35d1-wwdt";
		reg = <0x0 0x40440100 0x0 0x100>;
		interrupts = <GIC_SPI 44 IRQ_TYPE_LEVEL_HIGH>;	/* 76-32 */
		nuvoton,clk = <&clk>;
		clock-enable = "wdt1_gate";
		clock-names = "wwdt1_mux";
	};
```
