## Documentation/devicetree/bindings/phy/phy-ma35d1-usb.txt
```
Nuvoton ma35d1 USB PHY
=====================

Required properties:
--------------------
 - compatible: Must be "nuvoton,ma35d1-usb-phy".
 - #phy-cells: Must be 0.  See ./phy-bindings.txt for details.
 - clocks: Must contain an entry for each entry in clock-names.
   See ../clock/clock-bindings.txt for details.
 - nuvoton,sys: Must constain a phandle to the SYS node.

Example:
--------
	usb_phy: usb-phy {
		compatible = "nuvoton,ma35d1-usb-phy";
		clocks = <&clk usbd_gate>;
		clock-enable = "usbd_gate";
		nuvoton,sys = <&sys>;
		#phy-cells = <0>;
	};
```

## Documentation/devicetree/bindings/phy/phy-ma35d1-usb.yaml
```yaml
# SPDX-License-Identifier: GPL-2.0
%YAML 1.2
---
$id: http://devicetree.org/schemas/phy/phy-ma35d1-usb.yaml#
$schema: http://devicetree.org/meta-schemas/core.yaml#

title: Nuvoton MA35D1 USB2.0 phy

maintainers:
  - HPChen <hpchen0@nuvoton.com>

properties:
  compatible:
    enum:
      - nuvoton,ma35d1-usb-phy

  "#phy-cells":
    const: 0

  clocks:
    maxItems: 1
    description: USB PHY clock

  clock-names:
    const: usbd_gate

required:
  - compatible
  - clocks
  - clock-enable
  - "#phy-cells"

additionalProperties: false

examples:
  - |
    usb_phy: usb-phy {
        compatible = "nuvoton,ma35d1-usb-phy";
        clocks = <&clk USBD_GATE>;
        clock-names = "usbd_gate";
        clock-enable = "usbd_gate";
        nuvoton,sys = <&sys>;
        #phy-cells = <0>;
    };
```

## Documentation/devicetree/bindings/pinctrl/nuvoton,ma35d1-pinctrl.txt
```
* Nuvoton MA35D1 Pin Controller

Required properties for pin controller:
  - compatible: should be "nuvoton,ma35d1-pinctrl"
  - nuvoton,sys: phandle referencing a syscon providing MFP setting register


Required properties for pin configuration node:
  - nuvoton,pins: 4 integers array, representing
			1. MFP register offset
			2. Bitmask shift value
			3. MFP value
			4. Pin config

Examples:

#include "ma35d1-pinfunc.h"

...

	&gmac0 {
		pinctrl-names = "default";
		pinctrl-0 = <&pinctrl_gmac0>;
	};

	pinctrl: pinctrl {
		compatible = "nuvoton,ma35d1-pinctrl";
		nuvoton,sys = <&sys>;
		status = "okay";
		pcfg_default: pcfg-default {
			slew-rate = <0>;
			input-schmitt-disable;
			bias-disable;
		};
		gmac0 {
			pinctrl_gmac0: gmac0grp{
				nuvoton,pins =
					<SYS_GPE_MFPL_PE0MFP_RGMII0_MDC 	&pcfg_default>,
					<SYS_GPE_MFPL_PE1MFP_RGMII0_MDIO	&pcfg_default>,
					<SYS_GPE_MFPL_PE2MFP_RGMII0_TXCTL	&pcfg_default>,
					<SYS_GPE_MFPL_PE3MFP_RGMII0_TXD0	&pcfg_default>,
					<SYS_GPE_MFPL_PE4MFP_RGMII0_TXD1	&pcfg_default>,
					<SYS_GPE_MFPL_PE5MFP_RGMII0_RXCLK	&pcfg_default>,
					<SYS_GPE_MFPL_PE6MFP_RGMII0_RXCTL	&pcfg_default>,
					<SYS_GPE_MFPL_PE7MFP_RGMII0_RXD0	&pcfg_default>,
					<SYS_GPE_MFPH_PE8MFP_RGMII0_RXD1	&pcfg_default>,
					<SYS_GPE_MFPH_PE9MFP_RGMII0_RXD2	&pcfg_default>,
					<SYS_GPE_MFPH_PE10MFP_RGMII0_RXD3	&pcfg_default>,
					<SYS_GPE_MFPH_PE11MFP_RGMII0_TXCLK	&pcfg_default>,
					<SYS_GPE_MFPH_PE12MFP_RGMII0_TXD2	&pcfg_default>,
					<SYS_GPE_MFPH_PE13MFP_RGMII0_TXD3	&pcfg_default>;
			};
		};
	};
```

## Documentation/devicetree/bindings/pinctrl/nuvoton,ma35d1-pinctrl.yaml
```yaml
# SPDX-License-Identifier: GPL-2.0
%YAML 1.2
---
$id: http://devicetree.org/schemas/pinctrl/nuvoton,ma35d1-pinctrl.yaml#
$schema: http://devicetree.org/meta-schemas/core.yaml#

title: Nuvoton MA35D1 pin control and GPIO

maintainers:
  - Shan-Chun Hung <schung@nuvoton.com>

properties:
  compatible:
    enum:
      - nuvoton,ma35d1-pinctrl

  nuvoton,pin:
    description:
          Each entry consists of 4 parameters and represents the mux and config
          setting for one pin. The first 3 parameters <REGISTER_OFFSET BitMask_OFFSET 
          MFP_VALUE> are specified using a PIN_FUNC_ID macro, which can be found in 
          <inlcude/dt-bindings/pinctrl/ma35d1-pinfunc.h>. The last parameters config 
          is the pad setting value like bias-pull-up on this pin.
    $ref: /schemas/types.yaml#/definitions/uint32-matrix      

  reg:
    maxItems: 1

  '#address-cells':
    const: 2

  '#size-cells':
    const: 2
    
  nuvoton,sys:
    description:
      phandle to the sys
    $ref: /schemas/types.yaml#/definitions/phandle-array
    items:
      maxItems: 1

  ranges: true

patternProperties:
  "gpio@[a-n]+$":
    type: object
    properties:

      gpio-controller: true
      
      '#gpio-cells':
        const: 2

      reg:
        maxItems: 2

      clocks:
        maxItems: 1

      interrupt-controller: true

      '#interrupt-cells':
         const: 2
         
      interrupts:
        description:
                The interrupt outputs to sysirq.
        maxItems: 1

    required:
      - compatible
      - reg
      - interrupts
      - interrupt-controller
      - '#interrupt-cells'
      - gpio-controller
      - '#gpio-cells'

#PIN CONFIGURATION NODES
  "pcfg-[a-z0-9-]+$":
    type: object
    properties:
      bias-disable: true

      bias-pull-down: true

      bias-pull-up: true

      drive-strength:
        minimum: 0
        maximum: 7

      input-enable: true

      input-schmitt-enable: true
      
      power-source:
        description: 
          I/O voltage in millivolt.
        enum: [ 1800, 3300 ]
additionalProperties: false

examples:
  - |
    #include <dt-bindings/interrupt-controller/arm-gic.h>
    #include <dt-bindings/pinctrl/ma35d1-pinfunc.h>
    #include <dt-bindings/gpio/gpio.h>

    pinctrl: pinctrl {
        compatible = "nuvoton,ma35d1-pinctrl";
        nuvoton,sys = <&sys>;
        #address-cells = <2>;
        #size-cells = <2>;
        ranges;
        status = "okay";

        gpioa: gpioa@40040000 {
                reg = <0x0 0x40040000 0 0x40>,
                      <0x0 0x40040800 0 0x40>;
                interrupts = <GIC_SPI  14 IRQ_TYPE_LEVEL_HIGH>;
                clocks = <&clk GPA_GATE>;
                gpio-controller;
                #gpio-cells = <2>;
                interrupt-controller;
                #interrupt-cells = <2>;
        };
 
        pcfg_default: pcfg-default {
                slew-rate = <0>;
                input-schmitt-disable;
                bias-disable;
                power-source = <3300>;
                drive-strength = <0>;
        };
 
        uart13 {
                pinctrl_uart13: uart13grp {
                        nuvoton,pins =
                                <SYS_GPH_MFPH_PH12MFP_UART13_RXD	&pcfg_default>,
                                <SYS_GPH_MFPH_PH13MFP_UART13_TXD	&pcfg_default>;
                };
        };

    };

    uart13:serial@407D0000 {
        compatible = "nuvoton,ma35d1-uart";
        reg = <0x0 0x407D0000 0x0 0x10000>;
        interrupts = <GIC_SPI 119 IRQ_TYPE_LEVEL_HIGH>;
        clocks = <&clk UART2_GATE>;
        pinctrl-0 = <&pinctrl_uart13>;
    };
```

## Documentation/devicetree/bindings/pwm/ma35d1_pwm.txt
```
MA35D1 Enhanced Pulse Width Modulator(EPWM)

The chip provides three EPWM generators including EPWM0 ~ EPWM2
Each EPWM supports 6 channels.

Required Properties of EPWM:

- compatible : Should be "nuvoton,ma35d1-epwm"
- reg : address and length of the register for the device.
- clocks: Enable EPWM clock.

Example:

	pwm0: pwm0@40580000 {
		compatible = "nuvoton,ma35d1-epwm";
		reg = <0x0 0x40580000 0x0 0x10000>;
		clocks = <&clk epwm0_gate>;
		status = "okay";
	};
```

## Documentation/devicetree/bindings/regulator/ma35d1-regulator.txt
```
TWL family of regulators

Required properties:
For ma35d1 regulators/SDIO
- compatible:
  - "nuvoton,ma35d1-volt" for SDIO


Example:

	volt0_sdhci1: regulator-volt0_sdhci1 {
		compatible = "nuvoton,ma35d1-volt";
		regulator-min-microvolt = <1800000>;
		regulator-max-microvolt = <3300000>;
		regulator-name = "volt0_sdhci1";
		regulator-always-on;
        };
```

## Documentation/devicetree/bindings/remoteproc/ma35d1-rproc.txt
```
MA35D1 Co-Processor Bindings
----------------------------------------

This binding provides support for ARM Cortex M4 Co-processor found on
Nuvoton MA35D1 SoC.

Required properties:
- compatible		Should be "nuvoton, ma35d1-rproc"

Example:
	rproc {
		compatible	= "nuvoton, ma35d1-rproc";
	};
```

## Documentation/devicetree/bindings/reset/nuvoton,ma35d1-reset.txt
```
Binding for Nuvoton MA35D1 reset controller

Please also refer to reset.txt in this directory for common reset
controller binding usage.

Required Properties:
- compatible: has to be "nuvoton,ma35d1-reset"
- nuvoton,ma35d1-sys: phandle referencing a syscon providing reset control register
- #reset-cells : Specifies the number of cells needed to encode reset
                 line, should be 1

Example:

	reset: reset-controller {
		compatible = "nuvoton,ma35d1-reset";
		nuvoton,ma35d1-sys = <&sys>;
		#reset-cells = <1>;
	};
```

## Documentation/devicetree/bindings/rng/ma35d1-trng.txt
```
* Nuvoton MA35D1 True Random Number Generator

The true random number generator device is presented on Nuvoton MA35D1 SOC.

Required properties:

- compatible : Should be "nuvoton,ma35d1-trng"
- reg : address and length of the register for the device.
- interrupts: should contain TRNG interrupt number
- optee_nuvoton: support MAD35D1 TRNG driver link to OP-TEE TRNG PTA.


Example:

	/* TRNG */
        trng: trng@40B90000 {
		compatible = "nuvoton,ma35d1-trng";
		reg = <0x0 0x40B90000 0x0 0x400>;
		interrupts = <GIC_SPI 40 IRQ_TYPE_LEVEL_HIGH>;
		optee_nuvoton = "no";
		status = "okay";
        };
```

## Documentation/devicetree/bindings/rpmsg/ma35d1-rpmsg.txt
```
MA35D1 MA35D1 Shared Memory Bindings
----------------------------------------

This binding provides support for shared memory found on
Nuvoton MA35D1 SoC.

Required properties:
- compatible		Should be "nuvoton, ma35d1-rpmsg"
- share-mem-addr    Should be 0x24000000
- tx-smem-size, rx-smem-size    (tx-smem-size + rx-smem-size) <= 16K bytes

Example:
   rpmsg {
		compatible = "nuvoton,ma35d1-rpmsg";
		share-mem-addr = <0x24000000>;
		tx-smem-size = <128>;
		rx-smem-size = <128>;
	};
```

## Documentation/devicetree/bindings/rtc/nvt,ma35d1-rtc.yaml
```yaml
# SPDX-License-Identifier: GPL-2.0
%YAML 1.2
---
$id: http://devicetree.org/schemas/rtc/nvt,ma35d1-rtc.yaml#
$schema: http://devicetree.org/meta-schemas/core.yaml#

title: NVT MA35D1 RTC Device Tree Bindings

allOf:
  - $ref: "rtc.yaml#"

maintainers:
  - MJChen <mjchen@nuvoton.com>

properties:
  compatible:
    enum:
      - nuvoton,ma35d1-rtc

  reg:
    maxItems: 1

  interrupts:
    maxItems: 1

  clocks:
    maxItems: 1

required:
  - compatible
  - reg
  - interrupts
  - clocks

additionalProperties: false

examples:
  - |
    rtc@40410000 {
        compatible = "nuvoton,ma35d1-rtc";
        reg = <0x0 0x40410000 0x0 0x10000>;
        interrupts = <GIC_SPI 5 IRQ_TYPE_EDGE_RISING>;
        clocks = <&clk rtc_gate>;
    };

...
```

## Documentation/devicetree/bindings/serial/ma35d1_serial.txt
```
* Nuvoton MA35D1 SoC UART

Required properties:
- compatible: Should be "nuvoton,ma35d1-uart"
- reg: Should contain registers location and length
- interrupts: Interrupt specifier (see interrupt bindings for details)
- clocks: &clk uart0_gate ~ &clk uart17_gate clocks
- port-number: Select the port number of uart0~uart17 as 0~17
- pdma-enable: 0: disable pdma mode; 1: enable pdma mode

Optional properties:
- ma35d1-console: Select this port as the console

Example:

	uart1: serial@40710000 {
		compatible = "nuvoton,ma35d1-uart";
		reg = <00x0 0x40700000 0x0 0x10000>;
		interrupts = <GIC_SPI 59 IRQ_TYPE_EDGE_RISING>;
		clocks = <&clk uart0_gate>;
		port-number = <0>;
		pdma-enable = <0>;
	};
```

## Documentation/devicetree/bindings/serial/nvt,ma35d1-serial.yaml
```yaml
# SPDX-License-Identifier: (GPL-2.0-only OR BSD-2-Clause)
%YAML 1.2
---
$id: "http://devicetree.org/schemas/serial/serial.yaml#"
$schema: "http://devicetree.org/meta-schemas/core.yaml#"

title: NVT MA35D1 Serial Communication Interface

maintainers:
  - Rob Herring <robh@kernel.org>
  - Greg Kroah-Hartman <gregkh@linuxfoundation.org>

allOf:
  - $ref: rs485.yaml

properties:
  compatible:
    const: nuvoton,ma35d1-uart

  reg:
    maxItems: 1

  interrupts:
    maxItems: 1

  clocks:
    maxItems: 1

  port-number:
    $ref: /schemas/types.yaml#/definitions/uint32
    description: Select the port number of uart0~uart17 as 0~17

  pdma-enable:
    enum: [ 0, 1 ]

required:
  - compatible
  - reg
  - interrupts
  - clocks
  - port-number
  - pdma-enable

examples:
  - |
	uart1: serial@40710000 {
		compatible = "nuvoton,ma35d1-uart";
		reg = <00x0 0x40700000 0x0 0x10000>;
		interrupts = <GIC_SPI 59 IRQ_TYPE_EDGE_RISING>;
		clocks = <&clk uart0_gate>;
		port-number = <0>;
		pdma-enable = <0>;
	};
```

## Documentation/devicetree/bindings/sound/nuvoton,ma35d1-audio-i2s.txt
```
Nuvoton MA35D1 I2S controller

1. I2S driver
Required properties:
 - compatible : Must be "nuvoton,ma35d1-audio-i2s"
 - reg : Must contain I2S core's registers location and length
 - clocks : Specify I2S controller's clocks.
 - resets : Specify I2S IP reset number.
 - powerdown-gpios : Control the output of Audio JK_EN I/O pin.
 - pdma_reqsel_tx : Designate I2S Tx PDMA request number.
 - pdma_reqsel_rx : Designate I2S Rx PDMA request number.


Example:
	i2s0: i2s@40480000 {
		compatible = "nuvoton,ma35d1-audio-i2s";
		reg = <0x0 0x40480000 0x0 0x10000>;
		interrupts = <GIC_SPI 70 IRQ_TYPE_LEVEL_HIGH>;
		clocks = <&clk i2s0_gate>;
		resets = <&reset MA35D1_RESET_I2S0>;
		powerdown-gpios = <&gpiod 13 GPIO_ACTIVE_HIGH>; /* PD13 */
		pdma_reqsel_tx = <86>;
		pdma_reqsel_rx = <87>;
	};


2. I2S platform driver
Required properties:
 - compatible : Must be "nuvoton,ma35d1-audio-pcm"

Example:
	i2s_pcm: i2s_pcm {
		compatible = "nuvoton,ma35d1-audio-pcm";
	};

3. I2S Audio control driver
Required properties:
 - compatible : Must be "nuvoton,ma35d1-audio"
 - i2s-controller : Specify using which I2S controler for Audio codec
 - i2s-platform : Specify I2S platform driver

Example:
	sound {
		compatible = "nuvoton,ma35d1-audio";
		i2s-controller = <&i2s0>;
		i2s-platform = <&i2s_pcm>;
	};
```
